## CMakeLists.txt
```
cmake_minimum_required(VERSION 3.13.1)

set(BOARD_ROOT ${CMAKE_CURRENT_LIST_DIR}/..)

include($ENV{ZEPHYR_BASE}/cmake/app/boilerplate.cmake NO_POLICY_SCOPE)

project("Wireless UART")

target_sources(app
	PRIVATE
	src/main.c
	src/esb.c
	src/serial.c
	src/led.c
	src/app_shell.c)
```

## prj.conf
```kconfig
CONFIG_ESB=y
CONFIG_SPI=y
CONFIG_HEAP_MEM_POOL_SIZE=16384
CONFIG_SOC_SERIES_NRF52X=y
CONFIG_SOC_NRF52840_QIAA=y
CONFIG_ARM_MPU=y
CONFIG_CONSOLE=y
CONFIG_UART_CONSOLE=y
CONFIG_USE_SEGGER_RTT=y
CONFIG_UART_LINE_CTRL=y
CONFIG_GPIO_SHELL=y
CONFIG_USB=y
CONFIG_DISPLAY=y
CONFIG_HWINFO_SHELL=y
CONFIG_STACK_SENTINEL=y
CONFIG_ASSERT=y
CONFIG_LOG=y
# CONFIG_LOG_BACKEND_SHOW_COLOR is not set
CONFIG_SHELL=y
CONFIG_SHELL_PROMPT_UART="> "
CONFIG_UART_SHELL_ON_DEV_NAME="CDC_ACM_0"
CONFIG_SHELL_BACKEND_SERIAL_LOG_LEVEL_WRN=y
CONFIG_KERNEL_SHELL=y
CONFIG_DEVICE_SHELL=y
CONFIG_USB_COMPOSITE_DEVICE=y
CONFIG_USB_CDC_ACM=y
CONFIG_USB_CDC_ACM_DEVICE_COUNT=2
CONFIG_CHARACTER_FRAMEBUFFER=y
CONFIG_CHARACTER_FRAMEBUFFER_SHELL=y
CONFIG_DEBUG_OPTIMIZATIONS=y
```

## src/main.c
```c
#include "led.h"

#include <device.h>
#include <drivers/clock_control.h>
#include <esb.h>
#include <hal/nrf_clock.h>
#include <logging/log.h>
#include <usb/usb_device.h>
#include <zephyr.h>
#include <zephyr/types.h>

LOG_MODULE_REGISTER(Main);

extern const k_tid_t esb_thread;
extern const k_tid_t serial_thread;

K_MSGQ_DEFINE(esb_frame_q, sizeof(struct esb_payload), 100, 4);
K_MSGQ_DEFINE(serial_frame_q, sizeof(struct esb_payload), 100, 4);

void main(void)
{
	int err = 0;

	LOG_INF("Starting Application: %p", k_current_get());

	err = usb_enable(NULL);
	if (err != 0) {
		LOG_ERR("Failed to enable USB");
		return;
	}

	while (1) {
		led_flash(LED_GREEN);
		k_sleep(K_SECONDS(1));
	}
}
```

## src/app_shell.c
```c
#include <shell/shell.h>

LOG_MODULE_REGISTER(app_shell, LOG_LEVEL_DBG);

static int cmd_app_dummy(const struct shell *shell, size_t argc, char **argv)
{
	LOG_DBG("cmd_app_dummy");

	return 0;
}

SHELL_STATIC_SUBCMD_SET_CREATE(
    sub_app,
    SHELL_CMD(dummy, NULL, "APP", cmd_app_dummy),
    SHELL_SUBCMD_SET_END);

SHELL_CMD_REGISTER(app, &sub_app, "APP", NULL);
```

## src/esb.c
```c
#include "led.h"

#include <device.h>
#include <drivers/uart.h>
#include <esb.h>
#include <logging/log.h>
#include <stdio.h>
#include <string.h>
#include <zephyr.h>
#include <zephyr/types.h>

#define PRIORITY 3
#define STACKSIZE KB(10)
#define FRAME_TIME K_MSEC(10)
#define DEFAULT_BASE_ADDR_0                                                    \
	{                                                                      \
		0xE7, 0xE7, 0xE7, 0xE7                                         \
	}
#define DEFAULT_BASE_ADDR_1                                                    \
	{                                                                      \
		0xC2, 0xC2, 0xC2, 0xC2                                         \
	}
#define DEFAULT_ADDR_PREFIX                                                    \
	{                                                                      \
		0xE7, 0xC2, 0xC3, 0xC4, 0xC5, 0xC6, 0xC7, 0xC8                 \
	}

extern struct k_msgq esb_frame_q;
extern struct k_msgq serial_frame_q;

static int tx_frame_counter = 0;

LOG_MODULE_REGISTER(ESB, LOG_LEVEL_DBG);

void frame_timer_expiry_fn(struct k_timer *timer)
{
	int err = 0;

	if (esb_is_idle()) {
		err = esb_start_rx();
		if (err) {
			LOG_ERR("error starting RX mode");
		}
	} else if (esb_is_rx() && (tx_frame_counter > 0)) {
		err = esb_stop_rx();
		if (err) {
			LOG_ERR("error stopping RX mode: %d", err);
		}

		err = esb_start_tx();
		if (err) {
			LOG_ERR("error starting TX mode: %d", err);
		}
	}
}

K_TIMER_DEFINE(frame_timer, frame_timer_expiry_fn, frame_timer_expiry_fn);

void esb_event_callback(struct esb_evt const *event)
{
	int err = 0;
	struct esb_payload payload;

	led_flash(LED_BLUE);

	switch (event->evt_id) {
	case ESB_EVENT_TX_SUCCESS:
		LOG_DBG("ESB_EVENT_TX_SUCCESS");
		tx_frame_counter--;
		break;

	case ESB_EVENT_TX_FAILED:
		LOG_DBG("ESB_EVENT_TX_FAILED");
		err = esb_pop_tx();
		if (err) {
			LOG_ERR("error removing package");
		}
		tx_frame_counter--;
		break;

	case ESB_EVENT_RX_RECEIVED:
		err = esb_read_rx_payload(&payload);
		if (err) {
			LOG_ERR("error reading payload: %d", err);
			break;
		}

		err = k_msgq_put(&esb_frame_q, &payload, K_NO_WAIT);
		if (err) {
			LOG_WRN("error storing message: %d", err);
		}

		break;
	}

	k_timer_start(&frame_timer, K_NO_WAIT, FRAME_TIME);
}

void esb_thread_fn(void *arg0, void *arg1, void *arg2)
{
	LOG_INF("Starting thread: %p", k_current_get());

	int err = 0;

	u8_t base_addr_0[4] = DEFAULT_BASE_ADDR_0;
	u8_t base_addr_1[4] = DEFAULT_BASE_ADDR_1;
	u8_t addr_prefix[8] = DEFAULT_ADDR_PREFIX;

	struct esb_config config = ESB_DEFAULT_CONFIG;
	config.event_handler = esb_event_callback;
	config.tx_mode = ESB_TXMODE_MANUAL_START;

	err = esb_init(&config);
	__ASSERT(err == 0, "esb_init: %d", err);

	err = esb_set_base_address_0(base_addr_0);
	__ASSERT(err == 0, "esb_set_base_address_0: %d", err);

	err = esb_set_base_address_1(base_addr_1);
	__ASSERT(err == 0, "esb_set_base_address_1: %d", err);

	err = esb_set_prefixes(addr_prefix, ARRAY_SIZE(addr_prefix));
	__ASSERT(err == 0, "esb_set_prefixes: %d", err);

	err = esb_start_rx();
	__ASSERT(err == 0, "esb_start_rx: %d", err);

	k_timer_start(&frame_timer, K_NO_WAIT, FRAME_TIME);

	while (1) {
		static struct esb_payload payload = ESB_CREATE_PAYLOAD(0);

		if (tx_frame_counter >= CONFIG_ESB_TX_FIFO_SIZE) {
			k_sleep(FRAME_TIME);
			continue;
		}

		err = k_msgq_get(&serial_frame_q, &payload, K_FOREVER);
		if (err) {
			LOG_WRN("k_msgq_get: %d", err);
			continue;
		}

		err = esb_write_payload(&payload);
		if (err) {
			LOG_ERR("esb_write_payload: %d", err);
			continue;
		}

		tx_frame_counter++;
	}
}

K_THREAD_DEFINE(esb_thread, STACKSIZE, esb_thread_fn, NULL, NULL, NULL,
		PRIORITY, 0, 0);
```

## src/esb.h
```c
#ifndef __ESB_H__
#define __ESB_H__

void esb_init(void);

#endif // __ESB_H__
```

## src/heartbeat.c
```c
#include <gpio.h>
#include <logging/log.h>
#include <zephyr.h>
#include <zephyr/types.h>

#include "heartbeat.h"

LOG_MODULE_REGISTER(heartbeat);

static int err = 0;
static const char *led_controller = NULL;
static u32_t led_pin = 0;

static void heartbeat_expiry_fn(struct k_timer *timer)
{
	static int phase = 0;

	struct device *controller = device_get_binding(led_controller);
	if (!controller) {
		LOG_ERR("error binding device");
		return;
	}

	switch (phase++ % 32) {
	case 0:
		err = gpio_pin_write(controller, led_pin, 0);
		if (err) {
			LOG_ERR("error writing gpio: %d", err);
		}
		break;
	case 8:
		err = gpio_pin_write(controller, led_pin, 0);
		if (err) {
			LOG_ERR("error writing gpio: %d", err);
		}
		break;
	default:
		err = gpio_pin_write(controller, led_pin, 1);
		if (err) {
			LOG_ERR("error writing gpio: %d", err);
		}
		break;
	}

	phase %= 32;
}

K_TIMER_DEFINE(heartbeat_timer, heartbeat_expiry_fn, NULL);

int heartbeat_init(const char *controller, u32_t pin)
{
	led_controller = controller;
	led_pin = pin;

	struct device *device = device_get_binding(led_controller);
	if (!device) {
		LOG_ERR("error retrieving device: %d", err);
		return -ENODEV;
	}

	err = gpio_pin_configure(device, led_pin, GPIO_DIR_OUT);
	if (err) {
		LOG_ERR("error configuring gpio: %d", err);
		return err;
	}

	err = gpio_pin_write(device, led_pin, 1);
	if (err) {
		LOG_ERR("error writing gpio: %d", err);
		return err;
	}

	k_timer_start(&heartbeat_timer, 0, K_MSEC(40));

	return 0;
}
```

## src/heartbeat.h
```c
#ifndef HEARTBEAT_H
#define HEARTBEAT_H

int heartbeat_init(const char* led_controller, u32_t led_pin);

#endif // HEARTBEAT_H
```

## src/led.c
```c
#include <drivers/gpio.h>
#include <init.h>
#include <logging/log.h>
#include <zephyr.h>
#include <zephyr/types.h>

#include "led.h"

#define LED_ON 0
#define LED_OFF 1

#define LED_FLASH_TIMEOUT K_MSEC(50)

LOG_MODULE_REGISTER(LED);

static void _timer_0_expiry_fn(struct k_timer *timer)
{
	gpio_pin_set(device_get_binding(DT_ALIAS_LED0_GPIOS_CONTROLLER),
		     DT_ALIAS_LED0_GPIOS_PIN, LED_OFF);
}

static void _timer_1_expiry_fn(struct k_timer *timer)
{
	gpio_pin_set(device_get_binding(DT_ALIAS_LED1_GPIOS_CONTROLLER),
		     DT_ALIAS_LED1_GPIOS_PIN, LED_OFF);
}

static void _timer_2_expiry_fn(struct k_timer *timer)
{
	gpio_pin_set(device_get_binding(DT_ALIAS_LED2_GPIOS_CONTROLLER),
		     DT_ALIAS_LED2_GPIOS_PIN, LED_OFF);
}

static K_TIMER_DEFINE(_led_timer_0, _timer_0_expiry_fn, _timer_0_expiry_fn);
static K_TIMER_DEFINE(_led_timer_1, _timer_1_expiry_fn, _timer_1_expiry_fn);
static K_TIMER_DEFINE(_led_timer_2, _timer_2_expiry_fn, _timer_2_expiry_fn);

void led_flash(enum led led)
{
	struct device *led_controller = NULL;
	u32_t led_pin = 0;
	struct k_timer *led_timer = NULL;

	switch (led) {
	case LED_RED:
		led_controller =
			device_get_binding(DT_ALIAS_LED0_GPIOS_CONTROLLER);
		led_pin = DT_ALIAS_LED0_GPIOS_PIN;
		led_timer = &_led_timer_0;
		break;
	case LED_GREEN:
		led_controller =
			device_get_binding(DT_ALIAS_LED1_GPIOS_CONTROLLER);
		led_pin = DT_ALIAS_LED1_GPIOS_PIN;
		led_timer = &_led_timer_1;
		break;
	case LED_BLUE:
		led_controller =
			device_get_binding(DT_ALIAS_LED2_GPIOS_CONTROLLER);
		led_pin = DT_ALIAS_LED2_GPIOS_PIN;
		led_timer = &_led_timer_2;
		break;
	}

	gpio_pin_set(led_controller, led_pin, LED_ON);
	k_timer_start(led_timer, LED_FLASH_TIMEOUT, K_NO_WAIT);
}

static void _led_init(const char *device_name, u32_t led_pin)
{
	struct device *led_controller = device_get_binding(device_name);
	gpio_pin_configure(led_controller, led_pin, GPIO_DIR_OUT);
	gpio_pin_set(led_controller, led_pin, LED_OFF);
}

static int led_init()
{
	_led_init(DT_ALIAS_LED0_GPIOS_CONTROLLER, DT_ALIAS_LED0_GPIOS_PIN);
	_led_init(DT_ALIAS_LED1_GPIOS_CONTROLLER, DT_ALIAS_LED1_GPIOS_PIN);
	_led_init(DT_ALIAS_LED2_GPIOS_CONTROLLER, DT_ALIAS_LED2_GPIOS_PIN);

	return 0;
}

SYS_INIT(led_init, POST_KERNEL, CONFIG_APPLICATION_INIT_PRIORITY);
```

## src/led.h
```c
#ifndef LEDS_H
#define LEDS_H

enum led { LED_RED, LED_GREEN, LED_BLUE };

void led_flash(enum led led);

#endif // LEDS_H
```

## src/serial.c
```c
#include "led.h"

#include <device.h>
#include <drivers/uart.h>
#include <esb.h>
#include <logging/log.h>
#include <zephyr.h>
#include <zephyr/types.h>

#include <stdio.h>
#include <string.h>

#define PRIORITY 3
#define STACKSIZE KB(10)

LOG_MODULE_REGISTER(Serial, LOG_LEVEL_DBG);

extern struct k_msgq serial_frame_q;
extern struct k_msgq esb_frame_q;

void serial_callback(void *user_data)
{
	struct device *device = (struct device *)user_data;
	int err = 0;

	led_flash(LED_RED);
	uart_irq_update(device);

	if (uart_irq_rx_ready(device)) {
		static u8_t buffer[CONFIG_ESB_MAX_PAYLOAD_LENGTH];
		static struct esb_payload payload = ESB_CREATE_PAYLOAD(0);

		do {
			int received =
				uart_fifo_read(device, buffer, sizeof(buffer));

			if (received < 0) {
				LOG_ERR("error during uart_fifo_read: %d", err);
			}

			if (received == 0) {
				break;
			}

			memcpy(payload.data, buffer, received);
			payload.length = received;

			err = k_msgq_put(&serial_frame_q, &payload, K_NO_WAIT);
			if (err) {
				LOG_ERR("Error during serial queue put: %d",
					err);
			}
		} while (1);
	}
}

void serial_thread_fn(void *arg0, void *arg1, void *arg2)
{
	LOG_INF("Starting thread: %p", k_current_get());

	struct device *serial_device = device_get_binding("CDC_ACM_1");

	uart_irq_callback_user_data_set(serial_device, serial_callback,
					serial_device);
	uart_irq_rx_enable(serial_device);

	while (1) {
		static struct esb_payload payload;
		k_msgq_get(&esb_frame_q, &payload, K_FOREVER);
		uart_fifo_fill(serial_device, payload.data, payload.length);
	}
}

K_THREAD_DEFINE(serial_thread, STACKSIZE, serial_thread_fn, NULL, NULL, NULL,
		PRIORITY, 0, 0);
```

## src/serial.h
```c
#ifndef __SERIAL_H__
#define __SERIAL_H__

void serial_init(void);

#endif // __SERIAL_H__
```

## src/types.h
```c
#ifndef __TYPES_H__
#define __TYPES_H__

struct message_t
{
	u32_t RESERVED;
	u32_t length;
	u8_t data[32];
};

#endif // __TYPES_H__
```
