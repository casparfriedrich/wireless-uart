## boards/arm/reel_board/reel_board_defconfig
```kconfig
# SPDX-License-Identifier: Apache-2.0

CONFIG_ARM=y
CONFIG_SOC_FAMILY_NRF=y
CONFIG_SOC_SERIES_NRF52X=y
CONFIG_SOC_NRF52840_QIAA=y

# Enable MPU
CONFIG_ARM_MPU=y

# Board
CONFIG_BOARD_REEL_BOARD=y
```

## build/Kconfig.modules
```kconfig
osource "/home/caspar/Projects/ncs/nrf/Kconfig.nrf"

osource "/home/caspar/Projects/ncs/mcuboot/zephyr/Kconfig"

osource "/home/caspar/Projects/ncs/modules/lib/tinycbor/Kconfig.tinycbor"

osource "/home/caspar/Projects/ncs/nrfxlib/Kconfig.nrfxlib"
```
